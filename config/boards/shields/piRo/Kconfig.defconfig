## config/boards/shields/piRo/Kconfig.defconfig
```kconfig
if SHIELD_PIRO_R

config ZMK_KEYBOARD_NAME
    default "piRo_R"

config ZMK_SPLIT
    default y

config ZMK_SPLIT_ROLE_CENTRAL
    default y

config SPI
    default y

endif

if SHIELD_PIRO_L

config ZMK_KEYBOARD_NAME
    default "piRo_L"

config ZMK_SPLIT
    default y

endif
```

## config/boards/shields/piRo/Kconfig.shield
```kconfig
config SHIELD_PIRO_R
    def_bool $(shields_list_contains,piRo_R)

config SHIELD_PIRO_L
    def_bool $(shields_list_contains,piRo_L)
```

## config/west.yml
```yaml
manifest:
  remotes:
    - name: zmkfirmware
      url-base: https://github.com/zmkfirmware
    - name: pirorin215
      url-base: https://github.com/pirorin215
  projects:
    - name: zmk
      remote: zmkfirmware
      revision: main
      import: app/west.yml
    - name: zmk-pmw3610-driver
      remote: pirorin215
      revision: main
    - name: zmk-rgbled-widget
      remote: pirorin215
      revision: main
  self:
    path: config
```
